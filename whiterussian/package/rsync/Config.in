## whiterussian/package/rsync/Config.in
```kconfig
config BR2_PACKAGE_RSYNC
	tristate "rsync - Fast remote file copy program (like rcp)"
	select BR2_PACKAGE_LIBPOPT
	default m if CONFIG_DEVEL
	help
	  rsync is a program that allows files to be copied to
	  and from remote machines in much the same way as rcp.
	  It has many more options than rcp, and uses the rsync
	  remote-update protocol to greatly speed up file
	  transfers when the destination file already exists.
	  
	  The rsync remote-update protocol allows rsync to
	  transfer just the differences between two sets of files 
	  across the network link. 
	  
	  http://rsync.samba.org
endef
```

## whiterussian/package/samba/Config.in
```kconfig
menu "samba - The collection of programs that implements the SMB protocol for unix systems."

config BR2_COMPILE_SAMBA
	tristate
	default n
	depends BR2_PACKAGE_SAMBA_CLIENT || BR2_PACKAGE_SAMBA_COMMON || BR2_PACKAGE_SAMBA_SERVER
	help
	  The Samba software suite is a collection of programs that implements the
	  SMB protocol for unix systems, allowing you to serve files and printers to
	  Windows, NT, OS/2 and DOS clients. This protocol is sometimes also referred
	  to as the LanManager or Netbios protocol.
	  
	  URL:=http://www.samba.org/

config BR2_PACKAGE_SAMBA_COMMON
	tristate "samba-common - NetBIOS/SMB server and client shared files"
	default m if CONFIG_DEVEL
	select BR2_COMPILE_SAMBA
	select BR2_PACKAGE_LIBGCC
	help
	  This package contains NetBIOS/SMB server and client shared files.

config BR2_PACKAGE_SAMBA_CLIENT
	tristate "samba-client - NetBIOS/SMB simple client"
	default m if CONFIG_DEVEL
	select BR2_COMPILE_SAMBA
	select BR2_PACKAGE_SAMBA_COMMON
	help
	  This package contains NetBIOS/SMB simple client.

config BR2_PACKAGE_SAMBA_SERVER
	tristate "samba-server - NetBIOS/SMB file and print server"
	default m if CONFIG_DEVEL
	select BR2_COMPILE_SAMBA
	select BR2_PACKAGE_SAMBA_COMMON
	help
	  This package contains NetBIOS/SMB server.

endmenu
```

## whiterussian/package/sipcalc/Config.in
```kconfig
config BR2_PACKAGE_SIPCALC
	tristate "sipcalc - an advanced console based ip subnet calculator"
	default m if CONFIG_DEVEL
	help
	  Sipcalc is an advanced console based ip subnet calculator.
	  
	  http://www.routemeister.net/projects/sipcalc/index.html
```

## whiterussian/package/siproxd/Config.in
```kconfig
config BR2_PACKAGE_SIPROXD
	tristate "siproxd - SIP (Session Initiation Protocol) proxy"
	default m if CONFIG_DEVEL
	select BR2_PACKAGE_LIBOSIP2
	select BR2_PACKAGE_LIBPTHREAD
	help
	  A SIP (Session Initiation Protocol) proxy
	  
	  http://siproxd.sourceforge.net/
	  
	  Depends: libosip2
	  
```

## whiterussian/package/smtptrapd/Config.in
```kconfig
config BR2_PACKAGE_SMTPTRAPD
	tristate "smtptrapd - a SMTP Trap Daemon"
	default m if CONFIG_DEVEL
	select BR2_PACKAGE_LIBPTHREAD
	help
	  The smtptrapd program is a multi-threaded daemon that provides 
	  a RFC 2821 compliant SMTP service that always returns a 4xx soft 
	  error to the RCPT TO verb.
	  
	  http://smtptrapd.inodes.org/
```

## whiterussian/package/socat/Config.in
```kconfig
config BR2_PACKAGE_SOCAT
	tristate "socat - a multipurpose relay (SOcket CAT)"
	default m if CONFIG_DEVEL
	help
	  SoCat (for SOcket CAT) establishes two bidirectional byte streams and
	  transfers data between them.
	  Data channels may be files, pipes, devices (terminal or modem, etc.), or
	  sockets (Unix, IPv4, IPv6, raw, UDP, TCP, SSL). It provides forking,
	  logging and tracing, different modes for interprocess communication and
	  many more options.
	  
	  http://www.dest-unreach.org/socat/

config BR2_PACKAGE_SOCAT_TOOLS
	tristate "socat-tools - process utilities for socat"
	default m if CONFIG_DEVEL
	depends BR2_PACKAGE_SOCAT
	help
	  SoCat (for SOcket CAT) establishes two bidirectional byte streams and
	  transfers data between them.
	  Data channels may be files, pipes, devices (terminal or modem, etc.), or
	  sockets (Unix, IPv4, IPv6, raw, UDP, TCP, SSL). It provides forking,
	  logging and tracing, different modes for interprocess communication and
	  many more options.
	  
	  http://www.dest-unreach.org/socat/

config BR2_PACKAGE_SOCAT_NOSSL
	tristate "socat-nossl - a multipurpose relay (SOcket CAT) (without SSL support)"
	default m if CONFIG_DEVEL
	help
	  SoCat (for SOcket CAT) establishes two bidirectional byte streams and
	  transfers data between them.
	  Data channels may be files, pipes, devices (terminal or modem, etc.), or
	  sockets (Unix, IPv4, IPv6, raw, UDP, TCP, SSL). It provides forking,
	  logging and tracing, different modes for interprocess communication and
	  many more options.
	  This package is built without SSL support.
	  
	  http://www.dest-unreach.org/socat/

config BR2_PACKAGE_SOCAT_NOSSL_TOOLS
	tristate "socat-nossl-tools - process utilities for socat (without SSL support)"
	default m if CONFIG_DEVEL
	depends BR2_PACKAGE_SOCAT_NOSSL
	help
	  SoCat (for SOcket CAT) establishes two bidirectional byte streams and
	  transfers data between them.
	  Data channels may be files, pipes, devices (terminal or modem, etc.), or
	  sockets (Unix, IPv4, IPv6, raw, UDP, TCP, SSL). It provides forking,
	  logging and tracing, different modes for interprocess communication and
	  many more options.
	  This package is built without SSL support.
	  
	  http://www.dest-unreach.org/socat/
```

## whiterussian/package/spcaview/Config.in
```kconfig
menu "spca5xx based webcam utilities"

config BR2_COMPILE_SPCAVIEW
	tristate
	default n
	depends BR2_PACKAGE_SPCACAT || BR2_PACKAGE_SPCASERV

config BR2_PACKAGE_SPCACAT
	tristate "spcacat - a picture grabber"
	default m if CONFIG_DEVEL
	select BR2_COMPILE_SPCAVIEW
	select BR2_PACKAGE_LIBPTHREAD
	select BR2_PACKAGE_BASE_FILES_UCI
	help
	  A picture grabber for spca5xx based webcam with the raw jpeg feature.

config BR2_PACKAGE_SPCASERV
	tristate "spcaserv - a streaming TCP server"
	default m if CONFIG_DEVEL
	select BR2_COMPILE_SPCAVIEW
	select BR2_PACKAGE_LIBPTHREAD
	select BR2_PACKAGE_BASE_FILES_UCI
	help
	  A streaming TCP server for spca5xx based webcam with the raw jpeg feature.

endmenu
```

## whiterussian/package/tar/Config.in
```kconfig
config BR2_PACKAGE_TAR
	tristate "tar - a GNU file archiving program"
	default m if CONFIG_DEVEL
	help
	  The GNU tar program saves many files together in one archive and can
	  restore individual files (or all of the files) from that archive. Tar
	  can also be used to add supplemental files to an archive and to update
	  or list files in the archive. Tar includes multivolume support,
	  automatic archive compression/decompression, the ability to perform
	  remote archives, and the ability to perform incremental and full
	  backups.
	  
	  http://www.gnu.org/software/tar/
```

## whiterussian/package/tarfs/Config.in
```kconfig
config BR2_PACKAGE_TARFS
	tristate "tarfs - save/load ramfs /etc contents in mtd partition."
	default m if CONFIG_DEVEL
	depends BR2_TARGET_ROOTFS_SQUASHFS_LZMA
	help
	 save/load ramfs /etc contents in mtd partition.
```

## whiterussian/package/uclibc++/Config.in
```kconfig
config BR2_PACKAGE_UCLIBCPP
	tristate "uClibc++ - C++ library for embedded systems (0.1.11 compat)"
	default m if CONFIG_DEVEL
	help
	  A standard C++ library for embedded systems, the compatibility
	  release for packages explicitly linked against this version from
	  OpenWrt repositories.
```

## whiterussian/package/ulogd/Config.in
```kconfig
menu "ulogd - Netfilter userspace logging daemon"

config BR2_PACKAGE_ULOGD
	prompt "ulogd - Netfilter userspace logging daemon"
	tristate
	default m if CONFIG_DEVEL
	select BR2_PACKAGE_IPTABLES
	help
	  The netfilter userspace logging daemon
	  
	  http://gnumonks.org/projects/ulogd

config BR2_PACKAGE_ULOGD_MOD_MYSQL
	prompt "...-mod-mysql - Output plugin for logging to a MySQL database"
	tristate
	default m if CONFIG_DEVEL
	depends BR2_PACKAGE_ULOGD
	select BR2_PACKAGE_LIBMYSQLCLIENT

config BR2_PACKAGE_ULOGD_MOD_PCAP
	prompt"...-mod-pcap - Output plugin for logging in pcap format"
	tristate
	default m if CONFIG_DEVEL
	depends BR2_PACKAGE_ULOGD
	select BR2_PACKAGE_LIBPCAP

config BR2_PACKAGE_ULOGD_MOD_PGSQL
	prompt "...-mod-pgsql - Output plugin for logging to a PostgreSQL database"
	tristate
	default m if CONFIG_DEVEL
	depends BR2_PACKAGE_ULOGD
	select BR2_PACKAGE_LIBPQ

config BR2_PACKAGE_ULOGD_MOD_SQLITE
	prompt "...-mod-sqlite - Output plugin for logging to an SQLite database"
	tristate
	default m if CONFIG_DEVEL
	depends BR2_PACKAGE_ULOGD
	select BR2_PACKAGE_SQLITE3

config BR2_PACKAGE_ULOGD_MOD_EXTRA
	prompt "...-mod-extra - Extra plugins"
	tristate
	default m if CONFIG_DEVEL
	depends BR2_PACKAGE_ULOGD
	help
	  This package contains the LOCAL, LOGEMU, OPRINT, PWSNIFF and SYSLOG plugins.

endmenu
```

## whiterussian/package/unrar/Config.in
```kconfig
config BR2_PACKAGE_UNRAR
	tristate "unrar - a free utility for extracting, testing and viewing RAR archives"
	default m if CONFIG_DEVEL
	help
	  The unrar utility is a freeware program for extracting, testing and
	  viewing the contents of archives created with the RAR archiver version
	  1.50 and above.
	  
	  http://www.rarlab.com/rar_archiver.htm
```

## whiterussian/package/unzip/Config.in
```kconfig
config BR2_COMPILE_UNZIP
	tristate
	default m if CONFIG_DEVEL
	depends BR2_PACKAGE_UNZIP

config BR2_PACKAGE_UNZIP
	tristate "unzip - an extraction utility for archives compressed in .zip format"
	default m if CONFIG_DEVEL
	select BR2_COMPILE_UNZIP
	help
	  InfoZIP's unzip program. With the exception of multi-volume archives 
	  (ie, .ZIP files that are split across several disks using PKZIP's /& option), 
	  this can handle any file produced either by PKZIP, or the corresponding 
	  InfoZIP zip program.
	  
	  http://infozip.sourceforge.net/UnZip.html

config BR2_PACKAGE_UNZIP_TOOLS
	tristate "unzip tools - supporting utilities for the unzip"
	default m if CONFIG_DEVEL
	select BR2_COMPILE_UNZIP
	help
	  InfoZIP's unzip program. With the exception of multi-volume archives 
	  (ie, .ZIP files that are split across several disks using PKZIP's /& option), 
	  this can handle any file produced either by PKZIP, or the corresponding 
	  InfoZIP zip program.
	  
	  http://infozip.sourceforge.net/UnZip.html
```

## whiterussian/package/ushare/Config.in
```kconfig
config BR2_PACKAGE_USHARE
	prompt "ushare - A free UPnP A/V Media Server for Linux"
	tristate
	default m if CONFIG_DEVEL
	select BR2_PACKAGE_LIBUPNP
	select BR2_PACKAGE_LIBICONV
	select BR2_PACKAGE_BASE_FILES_UCI
	help
	 uShare is a UPnP (TM) A/V & DLNA Media Server. It implements the server 
	 component that provides UPnP media devices with information on available 
	 multimedia files. uShare uses the built-in http server of libupnp to stream 
	 the files to clients.
	 GeeXboX uShare is able to provide access to both images, videos, music or 
	 playlists files (see below for a complete file format support list). It 
	 does not act as an UPnP Media Adaptor and thus, can't transcode streams 
	 to fit the client requirements.
	 uShare is written in C for the GeeXboX project. It is designed to provide 
	 access to multimedia contents to GeeXboX but can of course be used by any 
	 other UPnP client device. It should compile and run on any modern POSIX 
	 compatible system such as Linux.
	 
	 http://ushare.geexbox.org/
```

## whiterussian/package/util-linux/Config.in
```kconfig
menu "util-linux - A collection of linux utilities (fdisk, losetup, swap-utils)."

config BR2_COMPILE_UTIL_LINUX
	tristate
	default n
	depends BR2_PACKAGE_FDISK || BR2_PACKAGE_LOSETUP || BR2_PACKAGE_SWAP_UTILS

config BR2_PACKAGE_FDISK
	tristate "fdisk - Partition table manipulation utility"
	default m if CONFIG_DEVEL
	select BR2_COMPILE_UTIL_LINUX
	help
	  This package contains an utility for managing disk partition tables.

config BR2_PACKAGE_LOSETUP
	tristate "losetup - Loopback devices setup and control utility"
	default m if CONFIG_DEVEL
	select BR2_PACKAGE_KMOD_LOOP
	select BR2_COMPILE_UTIL_LINUX
	help
	  This package contains an utility for managing loopback devices.

config BR2_PACKAGE_SWAP_UTILS
	tristate "swap-utils - Swap space management utilities"
	default m if CONFIG_DEVEL
	select BR2_COMPILE_UTIL_LINUX
	help
	  This package contains a collection of tools for managing swap space:
	  - mkswap
	  - swapon
	  - swapoff

endmenu
```
