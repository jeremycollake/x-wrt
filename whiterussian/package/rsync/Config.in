## whiterussian/package/webif/Config.in
```kconfig
menu "webif - OpenWrt Administrative Console"

config BR2_PACKAGE_WEBIF
 	select BR2_PACKAGE_IPKG_UPGRADE_FIX
	depends BR2_PACKAGE_WEBIF_THEME_XWRT
 	depends BR2_PACKAGE_HASERL
	select BR2_PACKAGE_IPKG
	tristate "webif^2 - HTTP Administrative Console"
	default y
	help
	  An HTTP based management console for OpenWrt.

config BR2_PACKAGE_WEBIF_THEME_XWRT
	tristate "webif-theme-xwrt - Original X-Wrt webif theme"
	select BR2_PACKAGE_WEBIF
	default m
	help
	  Original X-Wrt webif theme

config BR2_PACKAGE_WEBIF_THEME_ZEPHYR
	tristate "webif-theme-zephyr - Zephyr webif theme"
	select BR2_PACKAGE_WEBIF
	default m
	help
	  Zephyr webif theme

config BR2_PACKAGE_WEBIF_LANG_CA
	tristate "webif-lang-ca - Catalan language file for webif"
	select BR2_PACKAGE_WEBIF
	default m
	help
	  Catalan language file for webif

config BR2_PACKAGE_WEBIF_LANG_CS
	tristate "webif-lang-cs - Czech language file for webif"
	select BR2_PACKAGE_WEBIF
	default m
	help
	  Czech language file for webif

config BR2_PACKAGE_WEBIF_LANG_DA
	tristate "webif-lang-da - Danish language file for webif"
	select BR2_PACKAGE_WEBIF
	default m
	help
	  Danish language file for webif

config BR2_PACKAGE_WEBIF_LANG_DE
	tristate "webif-lang-de - German language file for webif"
	select BR2_PACKAGE_WEBIF
	default m
	help
	  German language file for webif

config BR2_PACKAGE_WEBIF_LANG_EE
	tristate "webif-lang-ee - Estonian language file for webif"
	select BR2_PACKAGE_WEBIF
	default m
	help
	  Estonian language file for webif

config BR2_PACKAGE_WEBIF_LANG_ES
	tristate "webif-lang-es - Spanish language file for webif"
	select BR2_PACKAGE_WEBIF
	default m
	help
	  Spanish language file for webif

config BR2_PACKAGE_WEBIF_LANG_FR
	tristate "webif-lang-fr - French language file for webif"
	select BR2_PACKAGE_WEBIF
	default m
	help
	  French language file for webif

config BR2_PACKAGE_WEBIF_LANG_HE
	tristate "webif-lang-he - Hebrew language file for webif"
	select BR2_PACKAGE_WEBIF
	default m
	help
	  Hebrew language file for webif

config BR2_PACKAGE_WEBIF_LANG_HR
	tristate "webif-lang-hr - Croatian language file for webif"
	select BR2_PACKAGE_WEBIF
	default m
	help
	  Croatian language file for webif

config BR2_PACKAGE_WEBIF_LANG_HU
	tristate "webif-lang-hu - Hungarian language file for webif"
	select BR2_PACKAGE_WEBIF
	default m
	help
	  Hungarian language file for webif

config BR2_PACKAGE_WEBIF_LANG_IT
	tristate "webif-lang-it - Italian language file for webif"
	select BR2_PACKAGE_WEBIF
	default m
	help
	  Italian language file for webif

config BR2_PACKAGE_WEBIF_LANG_NL
	tristate "webif-lang-nl - Dutch language file for webif"
	select BR2_PACKAGE_WEBIF
	default m
	help
	  Dutch language file for webif

config BR2_PACKAGE_WEBIF_LANG_NO
	tristate "webif-lang-no - Norwegian language file for webif"
	select BR2_PACKAGE_WEBIF
	default m
	help
	  Norwegian language file for webif

config BR2_PACKAGE_WEBIF_LANG_PL
	tristate "webif-lang-pl - Polish language file for webif"
	select BR2_PACKAGE_WEBIF
	default m
	help
	  Polish language file for webif

config BR2_PACKAGE_WEBIF_LANG_PT
        tristate "webif-lang-pt - Portuguese language file for webif"
	select BR2_PACKAGE_WEBIF
        default m
        help
          Portuguese language file for webif

config BR2_PACKAGE_WEBIF_LANG_RU
	tristate "webif-lang-ru - Russian language file for webif"
	select BR2_PACKAGE_WEBIF
	default m
	help
	  Russian language file for webif

config BR2_PACKAGE_WEBIF_LANG_SV
	tristate "webif-lang-sv - Swedish language file for webif"
	select BR2_PACKAGE_WEBIF
	default m
	help
	  Swedish language file for webif

config BR2_PACKAGE_WEBIF_LANG_UK
	tristate "webif-lang-uk - Ukrainian language file for webif"
	select BR2_PACKAGE_WEBIF
	default m
	help
	  Ukrainian language file for webif

config BR2_PACKAGE_WEBIF_LANG_ZH
	tristate "webif-lang-zh - Chinese Simplified language file for webif"
	select BR2_PACKAGE_WEBIF
	default m
	help
	  Chinese Simplified language file for webif
endmenu
```

## whiterussian/package/webif_hotspot/Config.in
```kconfig
menu "webif-hotspot"

config BR2_PACKAGE_WEBIF_HOTSPOT
	select BR2_PACKAGE_WEBIF
	tristate "webif_hotspot - HotSpot manager addon for the webif"
	default m
	help
	  A hotspot manager for the webif.

#config BR2_PACKAGE_WEBIF_HOTSPOT_LANG_*
#	depends BR2_PACKAGE_WEBIF_HOTSPOT
#	tristate "webif-hotspot-lang-* - * language file for webif hotspot"
#	depends BR2_PACKAGE_WEBIF_HOTSPOT
#	default m
#	help
#	  * language file for webif hotspot

endmenu
```

## whiterussian/package/wget/Config.in
```kconfig
config BR2_PACKAGE_WGET
	tristate "wget - a non-interactive network downloader"
	default m if CONFIG_DEVEL
	help
	  Wget is a network utility to retrieve files from the Web
	  using http and ftp, the two most widely used Internet
	  protocols. It works non-interactively, so it will work in
	  the background, after having logged off. The program supports
	  recursive retrieval of web-authoring pages as well as ftp
	  sites -- you can use wget to make mirrors of archives and
	  home pages or to travel the Web like a WWW robot.
	  
	  http://www.gnu.org/software/wget/index.html

config BR2_PACKAGE_WGET_NOSSL
	tristate "wget-nossl - a non-interactive network downloader (without SSL support)"
	default m if CONFIG_DEVEL
	help
	  Wget is a network utility to retrieve files from the Web
	  using http and ftp, the two most widely used Internet
	  protocols. It works non-interactively, so it will work in
	  the background, after having logged off. The program supports
	  recursive retrieval of web-authoring pages as well as ftp
	  sites -- you can use wget to make mirrors of archives and
	  home pages or to travel the Web like a WWW robot.
	  This package is built without SSL support.
	  
	  http://www.gnu.org/software/wget/index.html
```

## whiterussian/package/whois/Config.in
```kconfig
config BR2_PACKAGE_WHOIS
	tristate "whois - a client for the whois directory service"
	default m if CONFIG_DEVEL
	help
	  whois searches for an object in a RFC 3912 database.
	  
	  http://www.linux.it/~md/software/
```

## whiterussian/package/xrelayd/Config.in
```kconfig
config BR2_PACKAGE_XRELAYD
	tristate "xrelayd - the SSL tunnel based based on xyssl"
	default m if CONFIG_DEVEL
	select BR2_PACKAGE_LIBXYSSL
	help
	  A basic tcp proxy server which enables you to encrypt arbitrary
	  protocols without changing ssl unaware deamons and client software.
 
```

## whiterussian/package/xyssl/Config.in
```kconfig
config BR2_COMPILE_XYSSL
	tristate
	default n
	depends BR2_PACKAGE_LIBXYSSL


config BR2_PACKAGE_LIBXYSSL
	tristate "xyssl - a fast, open source SSL library"
	default m if CONFIG_DEVEL
	select BR2_COMPILE_XYSSL
	help
	  A quality, open-source cryptographic library written in C
	  and targeted at embedded systems.
	  
	  http://www.xyssl.org
 
config BR2_PACKAGE_XYSSLPROGS
	tristate "xysslprogs - SSL library support programs"
	default m if CONFIG_DEVEL
	depends BR2_PACKAGE_LIBXYSSL
	help
	  A quality, open-source cryptographic library written in C
	  and targeted at embedded systems.
	  
	  http://www.xyssl.org
```

## whiterussian/package/zip/Config.in
```kconfig
config BR2_COMPILE_ZIP
	tristate
	default m if CONFIG_DEVEL
	depends BR2_PACKAGE_ZIP

config BR2_PACKAGE_ZIP
	tristate "zip - a compression and file packaging/archive utility"
	default m if CONFIG_DEVEL
	select BR2_COMPILE_ZIP
	help
	  This is InfoZIP's zip program. It produces files that are fully 
	  compatible with the popular PKZIP program; however, the command line 
	  options are not identical. In other words, the end result is the same, 
	  but the methods differ.
	  
	  http://infozip.sourceforge.net/Zip.html

config BR2_PACKAGE_ZIP_TOOLS
	tristate "zip tools - supporting utilities for the zip"
	default m if CONFIG_DEVEL
	select BR2_COMPILE_ZIP
	help
	  This is InfoZIP's zip program. It produces files that are fully 
	  compatible with the popular PKZIP program; however, the command line 
	  options are not identical. In other words, the end result is the same, 
	  but the methods differ.
	  
	  http://infozip.sourceforge.net/Zip.html
```

## whiterussian/target/linux/package/mos7715/Config.in
```kconfig
config BR2_PACKAGE_KMOD_USB_MOS7715
	prompt "kmod-usb-mos7715 - Driver for USB converters using the Moschip MCS7715 Chip"
	tristate
	default m if CONFIG_DEVEL
	help
	  Driver for USB to Combo Serial & Printer converters using the Moschip MCS7715 Chip.
```

## whiterussian/target/linux/package/spca5xx/Config.in
```kconfig
config BR2_PACKAGE_KMOD_USB_SPCA5XX
	prompt "kmod-spca5xx - SPCA5XX based USB webcam support (Full Edition)"
	tristate
	default m
	depends BR2_PACKAGE_KMOD_VIDEODEV
	select BR2_PACKAGE_KMOD_USB
	help
	  Kernel driver for SPCA5XX based USB webcam support (Full Edition).
	  
	  http://mxhaard.free.fr/
```
