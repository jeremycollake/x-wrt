## whiterussian/package/gzip/Config.in
```kconfig
config BR2_PACKAGE_GZIP
	tristate "gzip - (GNU zip) is a compression utility."
	default m if CONFIG_DEVEL
	help
	  gzip (GNU zip) is a compression utility designed to be a 
	  replacement for compress.
	  http://www.gzip.org/
```

## whiterussian/package/htop/Config.in
```kconfig
config BR2_PACKAGE_HTOP
	tristate "htop - an interactive process viewer"
	default m if CONFIG_DEVEL
	select BR2_PACKAGE_LIBNCURSES
	help
	  This is htop, an interactive process viewer.
	  
	  http://htop.sourceforge.net/
```

## whiterussian/package/id3lib/Config.in
```kconfig
config BR2_PACKAGE_ID3LIB
	tristate "id3lib - an ID3v1/ID3v2 tag manipulation library"
	default m if CONFIG_DEVEL
	select BR2_PACKAGE_UCLIBCXX
	select BR2_PACKAGE_ZLIB
	help
	 id3lib is a software library for manipulating ID3v1/v1.1 and ID3v2 tags.
	 id3lib 3.0.x conforms to all ID3v2 standards up to and including 
	 the ID3v2.3.0 informal standard.  
	 
	 http://www.id3lib.org/
```

## whiterussian/package/int2human/Config.in
```kconfig
config BR2_PACKAGE_INT2HUMAN
	tristate "int2human - small utility to convert integers to human readable form."
	default m if CONFIG_DEVEL
	help
	 Small utility to convert integers to human readable form. Based on Busybox's code.
```

## whiterussian/package/iperf/Config.in
```kconfig
config BR2_PACKAGE_IPERF
	tristate "dsniff - Internet Protocol bandwidth measuring tool (single threaded)"
	default m if CONFIG_DEVEL
	select BR2_PACKAGE_UCLIBCXX
	help
	  Iperf is a modern alternative for measuring TCP and UDP bandwidth 
	  performance, allowing the tuning of various parameters and 
	  characteristics.
	  This package is built with the single thread support.
	  
	  http://dast.nlanr.net/Projects/Iperf/

config BR2_PACKAGE_IPERF_MT
	tristate "dsniff - Internet Protocol bandwidth measuring tool (multithreaded)"
	default m if CONFIG_DEVEL
	select BR2_PACKAGE_UCLIBCXX
	select BR2_PACKAGE_LIBPTHREAD
	help
	  Iperf is a modern alternative for measuring TCP and UDP bandwidth 
	  performance, allowing the tuning of various parameters and 
	  characteristics.
	  This package is built with the multithread support.
	  
	  http://dast.nlanr.net/Projects/Iperf/
```

## whiterussian/package/ipkg-upgrade-fix/Config.in
```kconfig
config BR2_PACKAGE_IPKG_UPGRADE_FIX
	select BR2_PACKAGE_IPKG
	tristate "ipkg-upgrade-fix - Warning for 'ipkg upgrade'."
	default y
	help
	  Shows warning about 'ipkg upgrade' when user tries to use it. User can still
	  execute 'ipkg upgrade' through a method to over-ride though.
```

## whiterussian/package/jpeg/Config.in
```kconfig
config BR2_PACKAGE_LIBJPEG
	tristate "libjpeg - The Independent JPEG Group's JPEG runtime library"
	default m if CONFIG_DEVEL
	help
	  The Independent JPEG Group's JPEG runtime library.

config BR2_PACKAGE_JPEG_TOOLS
	tristate "jpeg-tools - The Independent JPEG Group's JPEG manipulation tools"
	default m if CONFIG_DEVEL
	depends BR2_PACKAGE_LIBJPEG
	help
	  The Independent JPEG Group's JPEG manipulation tools.
```

## whiterussian/package/lcd4linux/Config.in
```kconfig
config BR2_PACKAGE_LCD4LINUX
	tristate "lcd4linux - LCD display utility"
	default m if CONFIG_DEVEL
	select BR2_PACKAGE_LIBNCURSES
	help
	  LCD4Linux is a small program that grabs information from the kernel and 
	  some subsystems and displays it on an external liquid crystal display.
	  
	  http://lcd4linux.bulix.org/
```

## whiterussian/package/libgd/Config.in
```kconfig
config BR2_PACKAGE_LIBGD
	tristate "libgd - The GD Graphics Library"
	default m if CONFIG_DEVEL
	select BR2_PACKAGE_LIBJPEG
	select BR2_PACKAGE_LIBPNG
	help
	 The GD Graphics Library
	 
	 http://www.boutell.com/gd/
```

## whiterussian/package/libiconv/Config.in
```kconfig
config BR2_COMPILE_LIBICONV
	tristate
	default m if CONFIG_DEVEL
	depends BR2_PACKAGE_LIBICONV

config BR2_PACKAGE_LIBICONV
	prompt "libiconv - Character set conversion library"
	tristate
	default m if CONFIG_DEVEL
	select BR2_COMPILE_LIBICONV
	help
	  This library provides an iconv() implementation, for use on systems 
	  which don't have one, or whose implementation cannot convert 
	  from/to Unicode.
	 
	  http://www.gnu.org/software/libiconv/

config BR2_PACKAGE_ICONV
	prompt "iconv - Character set conversion utility"
	tristate
	default m if CONFIG_DEVEL
	depends BR2_PACKAGE_LIBICONV
	help
	  The iconv program converts text from one encoding to another encoding. 
	 
	  http://www.gnu.org/software/libiconv/
```

## whiterussian/package/libnet-1.1.x/Config.in
```kconfig
config BR2_PACKAGE_LIBNET1
	tristate "libnet1 - Low-level packet creation library (v1.1.x)"
	default m if CONFIG_DEVEL
	select BR2_PACKAGE_LIBPCAP
	help
	  A low-level packet creation library.
	  
	  http://www.packetfactory.net/libnet/
	  
	  Depends: libpcap
	  
```

## whiterussian/package/libnet/Config.in
```kconfig
config BR2_PACKAGE_LIBNET0
	tristate "libnet0 - Low-level packet creation library"
	default m if CONFIG_DEVEL
	select BR2_PACKAGE_LIBPCAP
	help
	  A low-level packet creation library.
	  
	  http://www.packetfactory.net/libnet/
	  
	  Depends: libpcap
	  
```

## whiterussian/package/libpam/Config.in
```kconfig
config BR2_PACKAGE_LIBPAM
	prompt "libpam - a free implementation of the following DCE-RFC from Sunsoft"
	tristate
	default m if CONFIG_DEVEL
	help
	  Linux-PAM is a free implementation of the following DCE-RFC from Sunsoft.
	 
	  http://www.kernel.org/pub/linux/libs/pam
```

## whiterussian/package/lighttpd/Config.in
```kconfig
menu "lighttpd - Flexible and lightweight web server"

config BR2_PACKAGE_LIGHTTPD
	prompt "lighttpd - Flexible and lightweight web server"
	tristate 
	default m if CONFIG_DEVEL
	select BR2_PACKAGE_LIBOPENSSL
	select BR2_PACKAGE_LIBPCRE
	select BR2_PACKAGE_ZLIB
	select BR2_PACKAGE_LIBGDBM
	select BR2_PACKAGE_LIBXML2
	select BR2_PACKAGE_LIBPTHREAD
	select BR2_PACKAGE_LIBSQLITE
	select BR2_PACKAGE_LIGHTTPD_MOD_DIRLISTING
	select BR2_PACKAGE_LIGHTTPD_MOD_INDEXFILE
	select BR2_PACKAGE_LIGHTTPD_MOD_STATICFILE
	help
	  A flexible and lightweight web server.
	  
	  http://www.lighttpd.net/
	  
	  Depends: libopenssl, libpcre
	  

config BR2_PACKAGE_LIGHTTPD_MOD_ACCESS
	depends BR2_PACKAGE_LIGHTTPD
	prompt "...-mod-access - Access module"
	tristate 
	default m if CONFIG_DEVEL

config BR2_PACKAGE_LIGHTTPD_MOD_ACCESSLOG
	depends BR2_PACKAGE_LIGHTTPD
	prompt "...-mod-accesslog - Access logging module"
	tristate 
	default m if CONFIG_DEVEL

config BR2_PACKAGE_LIGHTTPD_MOD_ALIAS
	depends BR2_PACKAGE_LIGHTTPD
	prompt "...-mod-alias - Directory alias module"
	tristate 
	default m if CONFIG_DEVEL

config BR2_PACKAGE_LIGHTTPD_MOD_AUTH
	depends BR2_PACKAGE_LIGHTTPD
	prompt "...-mod-auth - Authentication module"
	tristate 
	default m if CONFIG_DEVEL

config BR2_PACKAGE_LIGHTTPD_MOD_CGI
	depends BR2_PACKAGE_LIGHTTPD
	prompt "...-mod-cgi - CGI module"
	tristate 
	default m if CONFIG_DEVEL

config BR2_PACKAGE_LIGHTTPD_MOD_COMPRESS
	depends BR2_PACKAGE_LIGHTTPD
	prompt "...-mod-cgi - Compress module"
	tristate 
	default m if CONFIG_DEVEL

config BR2_PACKAGE_LIGHTTPD_MOD_DIRLISTING
	depends BR2_PACKAGE_LIGHTTPD
	prompt "...-mod-dirlisting - Directory listing module"
	tristate 
	default m if CONFIG_DEVEL

config BR2_PACKAGE_LIGHTTPD_MOD_EVASIVE
	depends BR2_PACKAGE_LIGHTTPD
	prompt "...-mod-evasive - Evasive module"
	tristate 
	default m if CONFIG_DEVEL

config BR2_PACKAGE_LIGHTTPD_MOD_EVHOST
	depends BR2_PACKAGE_LIGHTTPD
	prompt "...-mod-evhost - Enhanced virtual hosting module"
	tristate 
	default m if CONFIG_DEVEL

config BR2_PACKAGE_LIGHTTPD_MOD_EXPIRE
	depends BR2_PACKAGE_LIGHTTPD
	prompt "...-mod-expire - Expire module"
	tristate 
	default m if CONFIG_DEVEL

config BR2_PACKAGE_LIGHTTPD_MOD_EXTFORWARD
	depends BR2_PACKAGE_LIGHTTPD
	prompt "...-mod-extforward - Extract forwarded module"
	tristate 
	default m if CONFIG_DEVEL

config BR2_PACKAGE_LIGHTTPD_MOD_FASTCGI
	depends BR2_PACKAGE_LIGHTTPD
	prompt "...-mod-fastcgi - FastCGI module"
	tristate 
	default m if CONFIG_DEVEL

config BR2_PACKAGE_LIGHTTPD_MOD_INDEXFILE
	depends BR2_PACKAGE_LIGHTTPD
	prompt "...-mod-indexfile - Indexfile module"
	tristate 
	default m if CONFIG_DEVEL

config BR2_PACKAGE_LIGHTTPD_MOD_PROXY
	depends BR2_PACKAGE_LIGHTTPD
	prompt "...-mod-proxy - Proxy module"
	tristate 
	default m if CONFIG_DEVEL

config BR2_PACKAGE_LIGHTTPD_MOD_REDIRECT
	depends BR2_PACKAGE_LIGHTTPD
	prompt "...-mod-redirect - URL redirection module"
	tristate 
	default m if CONFIG_DEVEL

config BR2_PACKAGE_LIGHTTPD_MOD_REWRITE
	depends BR2_PACKAGE_LIGHTTPD
	prompt "...-mod-rewrite - URL rewriting module"
	tristate 
	default m if CONFIG_DEVEL

config BR2_PACKAGE_LIGHTTPD_MOD_RRDTOOL
	depends BR2_PACKAGE_LIGHTTPD
	prompt "...-mod-rrdtool - RRD time-series data module"
	tristate 
	default m if CONFIG_DEVEL

config BR2_PACKAGE_LIGHTTPD_MOD_SCGI
	depends BR2_PACKAGE_LIGHTTPD
	prompt "...-mod-scgi - Simplified CGI module"
	tristate 
	default m if CONFIG_DEVEL

config BR2_PACKAGE_LIGHTTPD_MOD_SECDOWNLOAD
	depends BR2_PACKAGE_LIGHTTPD
	prompt "...-mod-secdownload - Secure download module"
	tristate 
	default m if CONFIG_DEVEL

config BR2_PACKAGE_LIGHTTPD_MOD_SETENV
	depends BR2_PACKAGE_LIGHTTPD
	prompt "...-mod-setenv - Environment variable setting module"
	tristate 
	default m if CONFIG_DEVEL

config BR2_PACKAGE_LIGHTTPD_MOD_SIMPLE_VHOST
	depends BR2_PACKAGE_LIGHTTPD
	prompt "...-mod-simple-vhost - Simple virtual hosting module"
	tristate 
	default m if CONFIG_DEVEL

config BR2_PACKAGE_LIGHTTPD_MOD_SSI
	depends BR2_PACKAGE_LIGHTTPD
	prompt "...-mod-ssi - SSI module"
	tristate 
	default m if CONFIG_DEVEL

config BR2_PACKAGE_LIGHTTPD_MOD_STATICFILE
	depends BR2_PACKAGE_LIGHTTPD
	prompt "...-mod-staticfile - Static file module"
	tristate 
	default m if CONFIG_DEVEL

config BR2_PACKAGE_LIGHTTPD_MOD_STATUS
	depends BR2_PACKAGE_LIGHTTPD
	prompt "...-mod-status - Server status display module"
	tristate 
	default m if CONFIG_DEVEL

config BR2_PACKAGE_LIGHTTPD_MOD_TRIGGER_B4_DL
	depends BR2_PACKAGE_LIGHTTPD
	prompt "...-mod-trigger-b4-dl - Anti-hot-linking module"
	tristate 
	default m if CONFIG_DEVEL

config BR2_PACKAGE_LIGHTTPD_MOD_USERDIR
	depends BR2_PACKAGE_LIGHTTPD
	prompt "...-mod-userdir - User directory module"
	tristate 
	default m if CONFIG_DEVEL

config BR2_PACKAGE_LIGHTTPD_MOD_USERTRACK
	depends BR2_PACKAGE_LIGHTTPD
	prompt "...-mod-usertrack - User tracking module"
	tristate 
	default m if CONFIG_DEVEL

config BR2_PACKAGE_LIGHTTPD_MOD_WEBDAV
	depends BR2_PACKAGE_LIGHTTPD
	prompt "...-mod-webdav - WebDAV module"
	tristate 
	default m if CONFIG_DEVEL

endmenu
```

## whiterussian/package/linuxigd/Config.in
```kconfig
config BR2_PACKAGE_LINUXIGD
	tristate "linuxigd - a UPNP daemon"
	default m if CONFIG_DEVEL
	select BR2_PACKAGE_IPTABLES
	select BR2_PACKAGE_LIBPTHREAD
	select BR2_PACKAGE_LIBUPNP
	help
	 It implements the UPnP Internet Gateway Device specification (IGD) 
	 and allows UPnP aware clients, such as MSN Messenger, Azureus or 
	 Miranda to work properly from behind a NAT firewall. 
```

## whiterussian/package/lua/Config.in
```kconfig
menu "lua - LUA programming language"

config BR2_PACKAGE_LUA
	tristate
	default m if CONFIG_DEVEL
	depends BR2_PACKAGE_LUA_INTERPRETER || BR2_PACKAGE_LUA_COMPILER || BR2_PACKAGE_LIBLUA

config BR2_PACKAGE_LUA_INTERPRETER
	tristate "lua - LUA programming language (interpreter)"
	default m if CONFIG_DEVEL
	select BR2_PACKAGE_LUA
	select BR2_PACKAGE_LIBLUA
	select BR2_PACKAGE_LIBREADLINE
	select BR2_PACKAGE_LIBNCURSES
	help
	  Lua is a powerful light-weight programming language designed for extending 
	  applications. Lua is also frequently used as a general-purpose, stand-alone 
	  language. Lua is free software.
	  
	  This package contains the LUA language interpreter.
	  
	  http://www.lua.org/

config BR2_PACKAGE_LUA_COMPILER
	tristate "luac - LUA programming language (compiler)"
	default m if CONFIG_DEVEL
	select BR2_PACKAGE_LUA
	select BR2_PACKAGE_LIBLUA
	help
	  Lua is a powerful light-weight programming language designed for extending 
	  applications. Lua is also frequently used as a general-purpose, stand-alone 
	  language. Lua is free software.
	  
	  This package contains the LUA language compiler.
	  
	   http://www.lua.org/

config BR2_PACKAGE_LUA_EXAMPLES
	tristate "lua-examples - LUA programming language (examples)"
	default m if CONFIG_DEVEL
	select BR2_PACKAGE_LUA
	select BR2_PACKAGE_LUA_INTERPRETER
	help
	  Lua is a powerful light-weight programming language designed for extending 
	  applications. Lua is also frequently used as a general-purpose, stand-alone 
	  language. Lua is free software.
	  
	  This package contains LUA language examples.
	  
	  http://www.lua.org/

config BR2_PACKAGE_LIBLUA
	tristate "liblua - LUA programming language (libraries)"
	default m if CONFIG_DEVEL
	select BR2_PACKAGE_LUA
	help
	  Lua is a powerful light-weight programming language designed for extending 
	  applications. Lua is also frequently used as a general-purpose, stand-alone 
	  language. Lua is free software.
	  
	  This package contains the LUA shared libraries, needed by other programs.
	  
	  http://www.lua.org/

endmenu
```

## whiterussian/package/miniupnpd/Config.in
```kconfig
config BR2_PACKAGE_MINIUPNPD
	tristate "miniupnpd - a small and capable UPNP daemon"
	default m if CONFIG_DEVEL
	select BR2_PACKAGE_IPTABLES
	select BR2_PACKAGE_BASE_FILES_UCI
	help
	 This is a small and capable UPNP daemon.
```

## whiterussian/package/monit/Config.in
```kconfig
config BR2_PACKAGE_MONIT
	tristate "monit - System services monitoring utility"
	select BR2_PACKAGE_LIBPTHREAD
	select BR2_PACKAGE_LIBOPENSSL
	default m if CONFIG_DEVEL
	help
	  An utility for monitoring services on a Unix system.
	  This package is built without SSL support.
	  
	  http://www.tildeslash.com/monit

config BR2_PACKAGE_MONIT_NOSSL
	tristate "monit-nossl - System services monitoring utility, without SSL support"
	select BR2_PACKAGE_LIBPTHREAD
	default m if CONFIG_DEVEL
	help
	  An utility for monitoring services on a Unix system.
	  This package is built without SSL support.
	  
	  http://www.tildeslash.com/monit
```

## whiterussian/package/nas/Config.in
```kconfig
config BR2_PACKAGE_NAS
	tristate "nas - proprietary Broadcom WPA Authenticator/Supplicant"
	default m
	help
	 Proprietary Broadcom WPA Authenticator/Supplicant
```

## whiterussian/package/ndisc/Config.in
```kconfig
menu "ndisc6/rdisc6/tcptraceroute6 - IPv6 discovery tools"

config BR2_PACKAGE_NDISC
	tristate
	default n
	depends BR2_PACKAGE_NDISC6 || BR2_PACKAGE_RDISC6

config BR2_PACKAGE_NDISC6
	tristate "ndisc6 - An ICMPv6 neighbour discovery tool"
	default m if CONFIG_DEVEL
	select BR2_PACKAGE_NDISC
	help
	  An ICMPv6 neighbour discovery tools
	  
	  http://people.via.ecp.fr/~rem/ndisc6/

config BR2_PACKAGE_RDISC6
	tristate "rdisc6 - An ICMPv6 router discovery tool"
	default m if CONFIG_DEVEL
	select BR2_PACKAGE_NDISC
	help
	  An ICMPv6 router discovery tool
	  
	  http://people.via.ecp.fr/~rem/ndisc6/

config BR2_PACKAGE_TCPTRACEROUTE6
	tristate "tcptraceroute6 - A TCP/IPv6-based traceroute implementation"
	default m if CONFIG_DEVEL
	select BR2_PACKAGE_NDISC
	help
	  A TCP/IPv6-based traceroute implementation
	  
	  http://people.via.ecp.fr/~rem/ndisc6/

endmenu
```
