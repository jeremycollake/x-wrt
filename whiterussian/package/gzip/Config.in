## whiterussian/package/net-snmp/Config.in
```kconfig
menu "net-snmp - Open source SNMP (Simple Network Management Protocol) implementation"

config BR2_PACKAGE_NET_SNMP
	tristate
	default n
	depends BR2_PACKAGE_LIBNETSNMP

config BR2_PACKAGE_LIBNETSNMP
	prompt "libnetsnmp - Open source SNMP implementation (librairies)"
	tristate
	default m if CONFIG_DEVEL
	select BR2_PACKAGE_NET_SNMP
	select BR2_PACKAGE_LIBELF
	help
	  Open source SNMP (Simple Network Management Protocol) implementation (libraries).
	  Simple Network Management Protocol (SNMP) is a widely used 
	  protocol for monitoring the health and welfare of network 
	  equipment (eg. routers), computer equipment and even devices 
	  like UPSs. Net-SNMP is a suite of applications used to implement 
	  SNMP v1, SNMP v2c and SNMP v3 using both IPv4 and IPv6.
	  
	  This package contains shared libraries, needed by other programs.

	  http://www.net-snmp.org/

config BR2_PACKAGE_SNMPD
	prompt "snmpd - Open source SNMP implementation (daemon)"
	tristate
	select BR2_PACKAGE_LIBNETSNMP
	default m if CONFIG_DEVEL
	help
	  Open source SNMP (Simple Network Management Protocol) implementation (daemon).
	  Simple Network Management Protocol (SNMP) is a widely used 
	  protocol for monitoring the health and welfare of network 
	  equipment (eg. routers), computer equipment and even devices 
	  like UPSs. Net-SNMP is a suite of applications used to implement 
	  SNMP v1, SNMP v2c and SNMP v3 using both IPv4 and IPv6.
	  
	  This package contains the SNMP agent, dynamically linked.

	  http://www.net-snmp.org/

config BR2_PACKAGE_SNMPD_STATIC
	prompt "snmpd-static - Open source SNMP implementation (daemon)"
	tristate
	select BR2_PACKAGE_LIBNETSNMP
	default m if CONFIG_DEVEL
	help
	  Open source SNMP (Simple Network Management Protocol) implementation (daemon).
	  Simple Network Management Protocol (SNMP) is a widely used 
	  protocol for monitoring the health and welfare of network 
	  equipment (eg. routers), computer equipment and even devices 
	  like UPSs. Net-SNMP is a suite of applications used to implement 
	  SNMP v1, SNMP v2c and SNMP v3 using both IPv4 and IPv6.
	  
	  This package contains the SNMP agent, statically linked.

	  http://www.net-snmp.org/

config BR2_PACKAGE_SNMP_UTILS
	prompt "snmp-utils - Open source SNMP implementation (utilities)"
	tristate
	select BR2_PACKAGE_LIBNETSNMP
	default m if CONFIG_DEVEL
	help
	  Open source SNMP (Simple Network Management Protocol) implementation (utilities).
	  Simple Network Management Protocol (SNMP) is a widely used 
	  protocol for monitoring the health and welfare of network 
	  equipment (eg. routers), computer equipment and even devices 
	  like UPSs. Net-SNMP is a suite of applications used to implement 
	  SNMP v1, SNMP v2c and SNMP v3 using both IPv4 and IPv6.
	  
	  This package contains SNMP client utilities.
	  
	  http://www.net-snmp.org/
endmenu
```

## whiterussian/package/ntp/Config.in
```kconfig
config BR2_PACKAGE_NTPD
	tristate "ntpd - a full featured reference NTP (Network Time Protocol) implementation"
	default m if CONFIG_DEVEL
	select BR2_PACKAGE_LIBELF
	select BR2_PACKAGE_READLINE
	select BR2_PACKAGE_NCURSES
	help
	  The full featured reference NTP (Network Time Protocol) implementation daemon.
	  
	  http://www.ntp.org/

config BR2_PACKAGE_NTPD_TOOLS
	tristate "ntpd-tools - a collection of helpfull utilities for ntpd"
	depends BR2_PACKAGE_NTPD
	help
	  A collection of helpfull utilities for the reference NTP 
	  (Network Time Protocol) implementation.
	  
	  http://www.ntp.org/
```

## whiterussian/package/p910nd/Config.in
```kconfig
config BR2_PACKAGE_P910ND
	tristate "p910nd - A small non-spooling printer server"
	default m if CONFIG_DEVEL
	help
	  A small non-spooling printer server.
	  
	  http://etherboot.sourceforge.net/p910nd/
```

## whiterussian/package/pppoesk/Config.in
```kconfig
config BR2_PACKAGE_PPPOESK
	tristate "pppoesk - a PPPoE session killer"
	default m if CONFIG_DEVEL
	select BR2_PACKAGE_LIBPCAP
	select BR2_PACKAGE_LIBNET1
	help
	  pppoesk is a small C program which goal is to terminate a bogus PPPoE 
	  session in an automatic way.
	  
	  http://www.loicp.eu/pppoesk/

config BR2_PACKAGE_PPPOESK_STATIC
	tristate "pppoesk-static - a PPPoE session killer"
	default m if CONFIG_DEVEL
	select BR2_PACKAGE_LIBPCAP
	select BR2_PACKAGE_LIBNET1
	help
	  pppoesk is a small C program which goal is to terminate a bogus PPPoE 
	  session in an automatic way.
	  This package contains the statically compiled program.
	  
	  http://www.loicp.eu/pppoesk/
```

## whiterussian/package/pptpd/Config.in
```kconfig
config BR2_PACKAGE_PPTPD
	prompt "pptpd - PPTP (Point-to-Point Tunneling Protocol) server"
	tristate
	default m if CONFIG_DEVEL
	select BR2_PACKAGE_KMOD_GRE
	select BR2_PACKAGE_PPP
	help
	  A Point-to-Point Tunneling Protocol server
	  
	  http://poptop.sourceforge.net/
	  

config BR2_PACKAGE_BCRELAY
	prompt "bcrelay - A broadcast packet repeater"
	tristate
	default m if CONFIG_DEVEL
	select BR2_PACKAGE_PPTPD
	help
	  A broadcast packet repeater for Point-to-Point Tunneling Protocol server
	  
	  http://poptop.sourceforge.net/
	  
```
