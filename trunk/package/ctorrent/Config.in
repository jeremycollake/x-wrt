## trunk/package/ctorrent/Config.in
```kconfig
config BR2_PACKAGE_CTORRENT
	prompt "ctorrent - console-based BitTorrent client"
	tristate
	default m if CONFIG_DEVEL
	select BR2_PACKAGE_LIBOPENSSL
	select BR2_PACKAGE_UCLIBCXX
	help
	  CTorrent is a BitTorrent client written in the C programming language, known to
	  be a very robust and mature programming language, which produces fast and
	  optimized application.
	  
	  http://www.rahul.net/dholmes/ctorrent/
```

## trunk/package/e2fsprogs/Config.in
```kconfig
menu "e2fsprogs - A collection of ext2 filesystem utilities."

config BR2_COMPILE_E2FSPROGS
	tristate
	default n
	depends BR2_PACKAGE_E2FSPROGS || BR2_PACKAGE_LIBUUID || BR2_PACKAGE_RESIZE2FS || BR2_PACKAGE_TUNE2FS

config BR2_PACKAGE_E2FSPROGS
	tristate "e2fsprogs - Ext2/3 filesystem utilities"
	default m if CONFIG_DEVEL
	select BR2_COMPILE_E2FSPROGS
	select BR2_PACKAGE_LIBUUID
	help
	  This package contains essential ext2 filesystem utilities which consists of 
	  e2fsck, mke2fs, badblocks, e2label, filefrag, and most of the other core ext2 
	  filesystem utilities.

config BR2_PACKAGE_LIBUUID
	tristate "libuuid - DCE compatible Universally Unique Identifier library"
	default m if CONFIG_DEVEL
	select BR2_COMPILE_E2FSPROGS
	help
	  Library for generating DCE compatible Universally Unique Identifiers.

config BR2_PACKAGE_RESIZE2FS
	tristate "resize2fs - Ext2 Filesystem resize utility"
	default m if CONFIG_DEVEL
	select BR2_COMPILE_E2FSPROGS
	help
	  Ext2 Filesystem resize utility.

config BR2_PACKAGE_TUNE2FS
	tristate "tune2fs - Ext2 Filesystem tune utility"
	default m if CONFIG_DEVEL
	select BR2_COMPILE_E2FSPROGS
	help
	  Ext2 Filesystem tune utility.

endmenu
```

## trunk/package/flashfs/Config.in
```kconfig
config BR2_PACKAGE_FLASHFS
	tristate "script to sync /etc with mtd partition holding .tar.gz."
	default y
	help
	 Script to sync /etc with mtd partition holding .tar.gz. For tinyfs only.
```

## trunk/package/hswebif/Config.in
```kconfig
config BR2_PACKAGE_HSWEBIF
	select BR2_PACKAGE_WEBIF
	tristate "hswebif - hotspot webif extensions"
	default m
	help
	  A web interface for configuring Hotspots.
```

## trunk/package/int2human/Config.in
```kconfig
config BR2_PACKAGE_INT2HUMAN
	tristate "int2human - small utility to convert integers to human readable form."
	default m
	help
	 Small utility to convert integers to human readable form. Based on Busybox's code.
```

## trunk/package/matrixssl/Config.in
```kconfig
config BR2_PACKAGE_LIBMATRIXSSL
	prompt "libmatrixssl - Embedded SSL implementation"
	tristate
	default m if CONFIG_DEVEL
	select BR2_PACKAGE_LIBPTHREAD
	help
	  PeerSec Networks open source MatrixSSL™ is an embedded SSL implementation 
	  designed for  small footprint applications and devices. PeerSec MatrixSSL 
	  allows secure management of remote devices. Several secure embedded Web 
	  servers also use MatrixSSL for their encryption layer.
	  
	  http://www.matrixssl.org/

config BR2_PACKAGE_MATRIXSSL
	tristate
	default BR2_PACKAGE_LIBMATRIXSSL
```

## trunk/package/matrixtunnel/Config.in
```kconfig
config BR2_PACKAGE_MATRIXTUNNEL
	prompt "matrixtunnel - SSL tunnel based on matrixssl"
	tristate
	default m if CONFIG_DEVEL
	select BR2_PACKAGE_LIBMATRIXSSL
	help
	  matrixtunnel is a stripped down version of stunnel 
	  based on matrixssl library.
	  
	  http://znerol.ch/svn/matrixtunnel/trunk/
```

## trunk/package/miniupnpd/Config.in
```kconfig
config BR2_PACKAGE_MINIUPNPD
	tristate "miniupnpd - a small and capable UPNP daemon"
	default m
	select BR2_PACKAGE_IPTABLES
	help
	 This is a small and capable UPNP daemon.
```

## trunk/package/ncurses/Config.in
```kconfig
config BR2_PACKAGE_LIBNCURSES
	prompt "libncurses - Terminal handling library"
	default m if CONFIG_DEVEL
	help
	  Terminal handling library
	  .
	  http://www.gnu.org/software/ncurses/


config BR2_PACKAGE_NCURSES
	tristate
	default BR2_PACKAGE_LIBNCURSES
```

## trunk/package/nzbget/Config.in
```kconfig
config BR2_PACKAGE_NZBGET
	tristate "nzbget - a console based newgroup binary downloader"
	default m if CONFIG_DEVEL
	select BR2_PACKAGE_LIBXML2
	select BR2_PACKAGE_LIBNCURSES
	help
	  NZBGet is a binary newsgrabber for Linux (and Unix and MacOS X where 
	  compatible), which downloads files from usenet based on information 
	  given in nzb-files.
	  .
	  http://sourceforge.net/projects/nzbget/ 
	
```

## trunk/package/qos-scripts/Config.in
```kconfig
config BR2_PACKAGE_QOS_SCRIPTS
	tristate "QoS module for OpenWrt."
	default m
	help
	 nbd's QoS scripts. A set of scripts that abstract QoS configuration
	 into a simple configuration file supporting stanzas that specify
	 any number of QoS entries.
```

## trunk/package/util-linux/Config.in
```kconfig
config BR2_COMPILE_UTIL_LINUX
	tristate
	help
	  A collection of linux utilities (fdisk, losetup, swap-utils).
	   
	  URL:=http://www.kernel.org/pub/linux/utils/util-linux/

config BR2_PACKAGE_UTIL_LINUX_FDISK
	tristate "fdisk - Partition table manipulation utility"
	default m if CONFIG_DEVEL
	select BR2_COMPILE_UTIL_LINUX
	help
	  This package contains an utility for managing disk partition tables.

config BR2_PACKAGE_UTIL_LINUX_LOSETUP
	tristate "losetup - Loopback devices setup and control utility"
	default m if CONFIG_DEVEL
	select BR2_PACKAGE_KMOD_LOOP
	select BR2_COMPILE_UTIL_LINUX
	help
	  This package contains an utility for managing loopback devices.

config BR2_PACKAGE_UTIL_LINUX_SWAP_UTILS
	tristate "swap-utils - Swap space management utilities"
	default m if CONFIG_DEVEL
	select BR2_COMPILE_UTIL_LINUX
	help
	  This package contains a collection of tools for managing swap space:
	  - mkswap
	  - swapon
	  - swapoff
```

## trunk/package/webif_freeloader/Config.in
```kconfig
menu "webif-freeloader"

config BR2_PACKAGE_WEBIF_FREELOADER
	depends BR2_PACKAGE_WEBIF	
	tristate "webif_freeloader - Download manager addon for the webif"
	default m
	help
	  A download manager for the webif.

config BR2_PACKAGE_WEBIF_LANG_CS
	select BR2_PACKAGE_WEBIF_FREELOADER
	tristate "webif-lang-cs - Czech language file for webif freeloader"
	depends BR2_PACKAGE_WEBIF_FREELOADER
	default m
	help
	  Czech language file for webif freeloader
endmenu
```

## trunk/package/webif_hotspot/Config.in
```kconfig
menu "webif-hotspot"

config BR2_PACKAGE_WEBIF_HOTSPOT
	depends BR2_PACKAGE_WEBIF	
	tristate "webif_hotspot - HotSpot manager addon for the webif"
	default m
	help
	  A hotspot manager for the webif.

#config BR2_PACKAGE_WEBIF_HOTSPOT_LANG_*
#	select BR2_PACKAGE_WEBIF_HOTSPOT
#	tristate "webif-freeloader-lang-* - * language file for webif freeloader"
#	depends BR2_PACKAGE_WEBIF_HOTSPOT
#	default m
#	help
#	  * language file for webif freeloader

endmenu
```

## trunk/package/wepkeygen/Config.in
```kconfig
config BR2_PACKAGE_WEPKEYGEN
	tristate "wepkeygen - generate wep keys based on passphrase."
	default m
	help
	 generates wwep keys based on a passphrase. This is supposed to use
	 the standardized algorithm for doing so.
```

## trunk/target/Config.in
```kconfig
menu "Target Root Filesystem"

	config BR2_TARGET_ROOTFS_JFFS2
		bool "jffs2"
		default y
		help
		  Build a jffs2 root filesystem

	config BR2_TARGET_ROOTFS_SQUASHFS_LZMA
		bool "squashfs-lzma"
		default y
		help
		  Build a squashfs-lzma root filesystem

	config BR2_TARGET_TAR_FS
        	bool "tiny"
	        default n
		depends BR2_TARGET_ROOTFS_SQUASHFS_LZMA
		help
	          Create a readonly file system with /etc in ram for small flash

endmenu

menu "Kernel Configuration / Device Support"

source "target/linux/Config.in"

endmenu
```

## whiterussian/package/base-files-uci/Config.in
```kconfig
config BR2_PACKAGE_BASE_FILES_UCI
	tristate "uci - UCI support files"
	default y
	help
	  UCI support file for packages backported from Kamikaze.
```

## whiterussian/package/bzip2/Config.in
```kconfig
config BR2_COMPILE_LIBBZIP2
	tristate
	default m if CONFIG_DEVEL
	depends BR2_PACKAGE_LIBBZIP2

config BR2_PACKAGE_LIBBZIP2
	tristate "libbzip2 - A free, high-quality data compressor library"
	default m if CONFIG_DEVEL
	select BR2_COMPILE_LIBBZIP2
	help
	  A freely available, patent free, high-quality data compressor library.
	  http://www.bzip.org/

config BR2_PACKAGE_BZIP2
	tristate "bzip2 - A free, high-quality data compressor utility"
	default m if CONFIG_DEVEL
	depends BR2_PACKAGE_LIBBZIP2
	help
	  A freely available, patent free, high-quality data compressor utility.
	  http://www.bzip.org/

config BR2_PACKAGE_BZIP2RECOVER
	tristate "bzip2recover - A free, high-quality data compressor recovery utility"
	default m if CONFIG_DEVEL
	depends BR2_PACKAGE_LIBBZIP2
	help
	  A freely available, patent free, high-quality compressed data recovery utility.
	  http://www.bzip.org/
```

## whiterussian/package/cabextract/Config.in
```kconfig
config BR2_PACKAGE_CABEXTRACT
	tristate "cabextract - an extraction utility for cabinet (.cab) archives"
	default m if CONFIG_DEVEL
	help
	  cabextract is a program which can extract files from cabinet (.cab) 
	  archives.
	  
	  http://www.kyz.uklinux.net/cabextract.php
```

## whiterussian/package/cpu/Config.in
```kconfig
config BR2_PACKAGE_CPU
	tristate "cpu - reports CPU utilization."
	default m if CONFIG_DEVEL
	help
	 reports CPU utilization as a percentage of used time slices in a period.
```

## whiterussian/package/ctorrent/Config.in
```kconfig
config BR2_PACKAGE_CTORRENT
	prompt "ctorrent - console-based BitTorrent client (with builtin SHA-1 support)"
	tristate
	default m if CONFIG_DEVEL
	select BR2_PACKAGE_UCLIBCXX
	help
	  CTorrent is a BitTorrent client written in the C programming language, known to
	  be a very robust and mature programming language, which produces fast and
	  optimized application.
	  
	  http://www.rahul.net/dholmes/ctorrent/

config BR2_PACKAGE_CTORRENT_OPENSSL
	prompt "ctorrent-ssl - console-based BitTorrent client (with  OpenSSL support)"
	tristate
	default m if CONFIG_DEVEL
	select BR2_PACKAGE_LIBOPENSSL
	select BR2_PACKAGE_UCLIBCXX
	help
	  CTorrent is a BitTorrent client written in the C programming language, known to
	  be a very robust and mature programming language, which produces fast and
	  optimized application.
	  
	  http://www.rahul.net/dholmes/ctorrent/
```

## whiterussian/package/e2fsprogs/Config.in
```kconfig
menu "e2fsprogs - A collection of ext2 filesystem utilities."

config BR2_COMPILE_E2FSPROGS
	tristate
	default n
	depends BR2_PACKAGE_E2FSPROGS || BR2_PACKAGE_LIBUUID || BR2_PACKAGE_RESIZE2FS || BR2_PACKAGE_TUNE2FS

config BR2_PACKAGE_E2FSPROGS
	tristate "e2fsprogs - Ext2/3 filesystem utilities"
	default m if CONFIG_DEVEL
	select BR2_COMPILE_E2FSPROGS
	select BR2_PACKAGE_LIBUUID
	help
	  This package contains essential ext2 filesystem utilities which consists of 
	  e2fsck, mke2fs, badblocks, e2label, filefrag, and most of the other core ext2 
	  filesystem utilities.

config BR2_PACKAGE_LIBUUID
	tristate "libuuid - DCE compatible Universally Unique Identifier library"
	default m if CONFIG_DEVEL
	select BR2_COMPILE_E2FSPROGS
	help
	  Library for generating DCE compatible Universally Unique Identifiers.

config BR2_PACKAGE_UUIDGEN
	tristate "uuidgen - a command-line utility to create a new UUID value"
	default m if CONFIG_DEVEL
	select BR2_COMPILE_E2FSPROGS
	help
	  uuidgen program creates a new universally unique identifier (UUID) 
	  using the libuuid library. The new UUID can reasonably be considered 
	  unique among all UUIDs created on the local system, and among UUIDs 
	  created on other systems in the past and in the future.

config BR2_PACKAGE_RESIZE2FS
	tristate "resize2fs - Ext2 Filesystem resize utility"
	default m if CONFIG_DEVEL
	select BR2_COMPILE_E2FSPROGS
	help
	  Ext2 Filesystem resize utility.

config BR2_PACKAGE_TUNE2FS
	tristate "tune2fs - Ext2 Filesystem tune utility"
	default m if CONFIG_DEVEL
	select BR2_COMPILE_E2FSPROGS
	help
	  Ext2 Filesystem tune utility.

endmenu
```

## whiterussian/package/empty/Config.in
```kconfig
config BR2_PACKAGE_EMPTY
	tristate "empty - Run applications under pseudo-terminal sessions"
	default m if CONFIG_DEVEL
	help
	  empty is an utility that provides an interface to execute and/or interact 
	  with processes under pseudo-terminal sessions (PTYs). This tool is 
	  definitely useful in programming of shell scripts designed to communicate 
	  with interactive programs like telnet, ssh, ftp, etc. In some cases, empty 
	  can be the simplest replacement for TCL/expect or other similar 
	  programming tools.
	  http://empty.sourceforge.net
```

## whiterussian/package/file/Config.in
```kconfig
config BR2_COMPILE_LIBMAGIC
	tristate
	default n
	depends BR2_PACKAGE_LIBMAGIC


config BR2_PACKAGE_LIBMAGIC
	tristate "libmagic - determines the file type using magic numbers"
	default m if CONFIG_DEVEL
	select BR2_COMPILE_LIBMAGIC
	select BR2_PACKAGE_ZLIB
	help
	  ftp://ftp.astron.com/pub/file/

config BR2_PACKAGE_FILE
	tristate "file - determines the file type using magic numbers"
	default m if CONFIG_DEVEL
	depends BR2_PACKAGE_LIBMAGIC
	help
	  File tests each argument in an attempt to classify it. There
	  are three sets of tests, performed in this order: filesystem
	  tests, magic number tests, and language tests. The first test
	  that succeeds causes the file type to be printed.
	  
	  Starting with version 4, the file command is not much more than
	  a wrapper around the "magic" library. 
	  
	  ftp://ftp.astron.com/pub/file/
```

## whiterussian/package/gmediaserver/Config.in
```kconfig
config BR2_PACKAGE_GMEDIASERVER
	tristate "gmediaserver - an UPnP music media server"
	default m if CONFIG_DEVEL
	select BR2_PACKAGE_ID3LIB
	select BR2_PACKAGE_LIBICONV
	select BR2_PACKAGE_LIBMAGIC
	select BR2_PACKAGE_LIBUPNP
	select BR2_PACKAGE_LIBPTHREAD
	help
	 GMediaServer is a server for UPnP media players like the
	 Netgear MP101, Linksys WMLS11B etc. It exports one or more
	 directories using the UPnP protocol so the mediaserver can
	 browse through them and play audio or video files.
```
